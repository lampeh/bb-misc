/*
* Copyright (C) 2013 Pantelis Antoniou <panto@antoniou-consulting.com>
*
* This program is free software; you can redistribute it and/or modify
* it under the terms of the GNU General Public License version 2 as
* published by the Free Software Foundation.
*/
/dts-v1/;
/plugin/;

/ {
	compatible = "ti,beaglebone", "ti,beaglebone-black";

	/* identification */
	part-number = "PRU-FLIPDOT-01";
	version = "00A0";

	/* state the resources this cape uses */
	exclusive-use =
		/* pins */
		"P9.31",	/* pru0: pr1_pru0_pru_r30_0 - mapped to r30[0]*/
		"P9.29",	/* pru0: pr1_pru0_pru_r30_1 - mapped to r30[1]*/
		"P9.30",	/* pru0: pr1_pru0_pru_r30_2 - mapped to r30[2]*/
		"P9.28",	/* pru0: pr1_pru0_pru_r30_3 - mapped to r30[3]*/
		"P9.42",	/* pru0: pr1_pru0_pru_r30_4 - mapped to r30[4]*/
		"P9.27",	/* pru0: pr1_pru0_pru_r30_5 - mapped to r30[5]*/
		"P9.41",	/* pru0: pr1_pru0_pru_r30_6 - mapped to r30[6]*/
		"P9.25",	/* pru0: pr1_pru0_pru_r30_7 - mapped to r30[7]*/
		"P8.45",	/* pru1: pr1_pru1_pru_r30_0 - mapped to r30[8]*/
		"P8.46",	/* pru1: pr1_pru1_pru_r30_1 - mapped to r30[9]*/
		"P8.43",	/* pru1: pr1_pru1_pru_r30_2 - mapped to r30[10]*/
		"P8.44",	/* pru1: pr1_pru1_pru_r30_3 - mapped to r30[11]*/
		"P8.41",	/* pru1: pr1_pru1_pru_r30_4 - mapped to r30[12]*/
		"P8.42",	/* pru1: pr1_pru1_pru_r30_5 - mapped to r30[13]*/
		"P8.12",	/* pru0: pr1_pru0_pru_r30_14 - mapped to r30[14]*/
		"P8.11",	/* pru0: pr1_pru0_pru_r30_15 - mapped to r30[15]*/

		/* pru0: pr1_pru0_pru_r30_8 is on MMC0_DAT3 */
		/* pru0: pr1_pru0_pru_r30_9 is on MMC0_DAT2 */
		/* pru0: pr1_pru0_pru_r30_10 is on MMC0_DAT1 */
		/* pru0: pr1_pru0_pru_r30_11 is on MMC0_DAT0 */
		/* pru0: pr1_pru0_pru_r30_12 is on MMC0_CLK */
		/* pru0: pr1_pru0_pru_r30_13 is on MMC0_CMD */

		/* hardware */
		"pru0",
		"pru1";

	fragment@0 {
		target = <&am33xx_pinmux>;
		__overlay__ {
			pru_pru_pins: pinmux_pru_pru_pins {
				pinctrl-single,pins = <
					0x190 0x25	/* mcasp0_aclkx.pr1_pru0_pru_r30_0, MODE5 | OUTPUT | PRU */
					0x194 0x25	/* mcasp0_fsx.pr1_pru0_pru_r30_1, MODE5 | OUTPUT | PRU */
					0x198 0x25	/* mcasp0_axr0.pr1_pru0_pru_r30_2, MODE5 | OUTPUT | PRU */
					0x19c 0x25	/* mcasp0_ahclkr.pr1_pru0_pru_r30_3, MODE5 | OUTPUT | PRU */
					0x1a0 0x25	/* mcasp0_aclkr.pr1_pru0_pru_r30_4, MODE5 | OUTPUT | PRU */
					0x1a4 0x25	/* mcasp0_fsr.pr1_pru0_pru_r30_5, MODE5 | OUTPUT | PRU */
					0x1a8 0x25	/* mcasp0_axr1.pr1_pru0_pru_r30_6, MODE5 | OUTPUT | PRU */
					0x1ac 0x25	/* mcasp0_ahclkx.pr1_pru0_pru_r30_7, MODE5 | OUTPUT | PRU */
					0x030 0x26	/* gpmc_ad12.pr1_pru0_pru_r30_14, MODE6 | OUTPUT | PRU */
					0x034 0x26	/* gpmc_ad13.pr1_pru0_pru_r30_15, MODE6 | OUTPUT | PRU */

					0x0a0 0x25	/* lcd_data0.pr1_pru1_pru_r30_0, MODE5 | OUTPUT | PRU */
					0x0a4 0x25	/* lcd_data1.pr1_pru1_pru_r30_1, MODE5 | OUTPUT | PRU */
					0x0a8 0x25	/* lcd_data2.pr1_pru1_pru_r30_2, MODE5 | OUTPUT | PRU */
					0x0ac 0x25	/* lcd_data3.pr1_pru1_pru_r30_3, MODE5 | OUTPUT | PRU */
					0x0b0 0x25	/* lcd_data4.pr1_pru1_pru_r30_4, MODE5 | OUTPUT | PRU */
					0x0b4 0x25	/* lcd_data5.pr1_pru1_pru_r30_5, MODE5 | OUTPUT | PRU */
				>;
			};
		};
	};

	fragment@2 {
		target = <&pruss>;
		__overlay__ {
			status = "okay";

			pinctrl-names = "default";
			pinctrl-0 = <&pru_pru_pins>;
		};
	};
};
